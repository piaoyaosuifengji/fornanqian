

//**********************************************************
//** 版权:  杭州利尔达科技有限公司
//** 文件名: touch_key.c
//** 版本:1.0
//** 工作环境: IAR 4.11 
//** 作者: ZHAO YUAN GUO
//** 生成日期: 2008.11
//** 功能: 触摸按键,触摸按键时在LCD上显示相应的键值
//** 修改日志：无
/*************************************************************/
//==================================================================

//=====================定义常数=====================================
//
//==================================================================

//=====================定义变量=====================================

//==================================================================

//=====================子函数声明===================================
//
//
//==================================================================

//=====================包含头文件===================================
#include "msp430x26x.h"
#include "I2C_Serve.c"
#include "Segment_LCD.c"
#include"subroutine.h"
#include"subroutine.c"
//==================================================================

//==================================================================
//函数名称：void main(void)
//入口参数：空
//返回数据：空
//函数功能：系统主函数
//==================================================================
void main()
{
  WDTCTL=WDTPW+WDTHOLD;                                                //关闭看门狗
  unsigned int i;
  Init_Mcu_Key();                                                       //初始化处理器  
  Init_MCU_LCD();
  init_BU9796FS();                                                      //初始化LCD驱动
  for(i=0;i<NUM_KEYS;i++)                                               //初始化按键形成地平面
  {
    Init_Key(&key[i],&key_config[i]);
  }
  for(i=0;i<100;i++)                                                    //多次扫描按键等待时钟的稳定
  {
    Scan_Key();
  }
  
  for(i=0;i<NUM_KEYS;i++)                                               //读取各个按键的基本电容量
  {
    key[i].base_capacitance=key[i].filtered>>4;
    key[i].filtered=0;
  }    
  while(1)
  { 
    Scan_Key();                                                         //按键扫描
    reg_key_value=find_mean_position();                                 //获取键值
    Lcd_Display(reg_key_value);                                         //显示当前键值
  }    
}

